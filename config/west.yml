## config/west.yml
```yaml
manifest:
  remotes:
    - name: PippinW
      url-base: https://github.com/PippinW
  projects:
    - name: zmk
      remote: PippinW
      revision: rebound_v4
      import: app/west.yml
  self:
    path: config
```
